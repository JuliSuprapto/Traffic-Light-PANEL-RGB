#include <avr/pgmspace.h>
#include <stdlib.h>
#include <SPI.h>
#include <SoftwareSerial.h>
#include <assert.h>
#define R 11 // Uno PD2
#define LAT 12  // Uno PD3
#define CLK 13  // Uno PD4
#define B 10 // Uno PD5
#define A 9 // Uno PD6
#define OE 8 // Uno PD7

SoftwareSerial mySerial(2, 3); // RX, TX

int modul;
byte garis;
byte bitPos;
int kecerahan = 1000;
int kegelapan = 10;
int shiftRegKol;
byte kanvas[6][4][16];
long waktu;
byte dx, dy;
String string;
char command;
String readString ="";
char c;

void setup() {
  randomSeed(analogRead(0));
  SPI.begin();
  Serial.begin(9600);
  readString = "";
  pinMode(R, OUTPUT);
  pinMode(CLK, OUTPUT);
  pinMode(LAT, OUTPUT);
  pinMode(OE, OUTPUT);
  pinMode(A, OUTPUT);
  pinMode(B, OUTPUT);
  pinMode(OE, OUTPUT);
  digitalWrite(OE, 1);
}

const byte logoTE [26] [4] PROGMEM = {
  { 255, 255, 243, 192 },
  { 255, 255, 243, 192 },
  { 255, 255, 243, 192 },
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  { 255, 255, 255, 192 },
};

// Menggambar logo Telehouse di koordinat pojok kiri bawah P1(x0, y0)
void cetakLogoTE(const byte x0, const byte y0) {
  int x0i = x0;
  for (byte col = 1; col <= 26; col++) { //membaca kolom pertama dari logo
    byte temp1 = pgm_read_byte (logoTE [col][0]); // baca kolom dari huruf
    for (byte bitPos = 1; bitPos <= 7; bitPos++) {
      if (bit_is_set(temp1, bitPos - 1)) {
        setPixel(x0i + x0 + col,  y0 + 7 - bitPos);
      } // bit_is_set
    }// bitPos
    x0i++;
    temp1 = pgm_read_byte (logoTE [col][1]); // baca kolom dari huruf
    for (byte bitPos = 1; bitPos <= 7; bitPos++) {
      if (bit_is_set(temp1, bitPos - 1)) {
        setPixel(x0i + x0 + col,  y0 + 7 + 8 - bitPos);
      } // bit_is_set
    }// bitPos
    x0i++;
    temp1 = pgm_read_byte (logoTE [col][2]); // baca kolom dari huruf
    for (byte bitPos = 1; bitPos <= 7; bitPos++) {
      if (bit_is_set(temp1, bitPos - 1)) {
        setPixel(x0i + x0 + col,  y0 + 7 + 16 - bitPos);
      } // bit_is_set
    }// bitPos
    x0i++;
    temp1 = pgm_read_byte (logoTE [col][3]); // baca kolom dari huruf
    for (byte bitPos = 1; bitPos <= 2; bitPos++) {
      if (bit_is_set(temp1, bitPos - 1)) {
        setPixel(x0i + x0 + col,  y0 + 7 + 24 - bitPos);
      } // bit_is_set
    }// bitPos


  } // komplit satu huruf
} // end of cetakLogo

// pola bit font CP437
const byte cp437_font [127] [9] PROGMEM = {
  { 8,  0x00, 0x00, 0x00, 0x00, 0x00, 0x00, 0x00, 0x00 }, // ASCII 0x00
  { 8,  0x7E, 0x81, 0x95, 0xB1, 0xB1, 0x95, 0x81, 0x7E }, // 0x01
  { 8,  0x7E, 0xFF, 0xEB, 0xCF, 0xCF, 0xEB, 0xFF, 0x7E }, // 0x02
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  { 7,  0x02, 0x03, 0x01, 0x03, 0x02, 0x03, 0x01, 0x00 }, // '~'
};  //  end of cp437_font

void cetakString(const char * s, const byte x0, const byte y0) {
  int x0i = x0;
  byte bitPos, column;
  char c;
  while (c = *s++) {
    byte jmlByte = pgm_read_byte (&cp437_font [c] [0]); // baca kolom dari huruf
    for (byte col = 1; col <= jmlByte; col++) { //membaca byte pertama dari huruf c
      byte temp1 = pgm_read_byte (&cp437_font [c] [col]); // baca kolom dari huruf
      for (byte bitPos = 1; bitPos <= 8; bitPos++) {
        if (bit_is_set(temp1, bitPos - 1)) {
          setPixel(x0i + col - 1,  y0 + 7 - bitPos);
        } // bit_is_set
      }// bitPos
      //x0i++;
    } // komplit satu huruf
    x0i += jmlByte + 1; // geser kanan satu huruf bila boleh
  } // komplit satu string huruf
} // end of cetakString

void setPixel(byte absis, byte ordinat) {
  modul = int(ordinat / 16) * 3 + int(absis / 32);
  shiftRegKol = (int (absis / 8) % 4);
  bitPos = 7 - (absis % 8);
  byte row = ordinat % 16;
  kanvas[modul][shiftRegKol][row] |= (1 << bitPos);
}

void resetPixel(byte absis, byte ordinat) {
  modul = int(ordinat / 16) * 3 + int(absis / 32);
  shiftRegKol = (int (absis / 8) % 4);
  bitPos = 7 - (absis % 8);
  byte row = ordinat % 16;
  kanvas[modul][shiftRegKol][row] &= ~(1 << bitPos);
}

void clearKanvas() {
  for (int x = 0; x < 96; x++) {
    for (int y = 0; y < 32; y++)
      resetPixel(x, y);
  }
}

//ukuran kanvasTertata[4][4][16]
// format penataBaris(byteIdx, row)
byte penataBaris[4][16] = {
  {0, 0, 0, 0, 1, 1, 1, 1, 2, 2, 2, 2, 3, 3, 3, 3},
  {0, 0, 0, 0, 1, 1, 1, 1, 2, 2, 2, 2, 3, 3, 3, 3},
  {0, 0, 0, 0, 1, 1, 1, 1, 2, 2, 2, 2, 3, 3, 3, 3},
  {0, 0, 0, 0, 1, 1, 1, 1, 2, 2, 2, 2, 3, 3, 3, 3},
};

byte penataKolom[4][16] = {
  {0, 4, 8, 12, 0, 4, 8, 12, 0, 4, 8, 12, 0, 4, 8, 12},
  {1, 5, 9, 13, 1, 5, 9, 13, 1, 5, 9, 13, 1, 5, 9, 13},
  {2, 6, 10, 14, 2, 6, 10, 14, 2, 6, 10, 14, 2, 6, 10, 14},
  {3, 7, 11, 15, 3, 7, 11, 15, 3, 7, 11, 15, 3, 7, 11, 15},
};

void cetakKanvas() {
  for (byte gr = 4; gr > 0; gr--) {
    garis = gr - 1 ;
    func1();
  }
}

void func1() {
  digitalWrite(LAT, 0); //
  //digitalWrite(OE, 0); // disable disp
  delayMicroseconds(50);
  digitalWrite(B, bitRead(garis, 1)); //
  digitalWrite(A, bitRead(garis, 0)); //
  for (int modul = 0; modul < 6; modul++) {
    for (shiftRegKol = 0; shiftRegKol < 4; shiftRegKol++) {
      for (int baris = 0; baris < 16; baris += 4) {
        byte temp = kanvas[modul][shiftRegKol][baris + (3 - garis)];
        SPI.transfer(~temp); //
        //shiftOut(R, CLK, MSBFIRST, ~temp);
      }
    }
  } // modul
  digitalWrite(LAT, 1);
  digitalWrite(OE, 1); // enable disp
  delayMicroseconds(kecerahan);
  digitalWrite(OE, 0); // disable disp
}

void gambarCakram(int xP, int yP, int radius) {
  byte xMin = xP - radius;
  byte xMax = xP + radius;
  byte yMin = yP - radius;
  byte yMax = yP + radius;
  for (byte x = xMin; x <= xMax; x++) {
    for (byte y = yMin; y <= yMax; y++) {
      float jarakSqr = (x - xP) * (x - xP) + (y - yP) * (y - yP);
      if ((jarakSqr - (radius * radius)) <= 1) setPixel(x, y);
    }
  }
}

void hapusCakram(int xP, int yP, int radius) {
  byte xMin = xP - radius;
  byte xMax = xP + radius;
  byte yMin = yP - radius;
  byte yMax = yP + radius;
  for (byte x = xMin; x <= xMax; x++) {
    for (byte y = yMin; y <= yMax; y++) {
      float jarakSqr = (x - xP) * (x - xP) + (y - yP) * (y - yP);
      if ((jarakSqr - (radius * radius)) <= 1) resetPixel(x, y);
    }
  }
}

void loop()
{
  readString = "";
  while(!Serial.available()) {}
  // serial read section 
  while (Serial.available() > 0)
  {      
    delay(10);
    c = (char)Serial.read();  //gets one byte from serial buffer
    readString += c;           
  }
  delay(30);
  if (readString.length() > 0)
  {
    Serial.flush();
    Serial.print("Arduino received: ");
    Serial.print(readString); //see what was received
  }
  //readString ="";
  delay(500);
  Serial.print("\n");
  clearKanvas();
  teks();
}
  String text1 = "";
  String text2 = "";
  String text3 = "";

  char** str_split(char* a_str, const char a_delim)
{
    char** result    = 0;
    size_t count     = 0;
    char* tmp        = a_str;
    char* last_comma = 0;
    char delim[2];
    delim[0] = a_delim;
    delim[1] = 0;

    /* Count how many elements will be extracted. */
    while (*tmp)
    {
        if (a_delim == *tmp)
        {
            count++;
            last_comma = tmp;
        }
        tmp++;
    }

    /* Add space for trailing token. */
    count += last_comma < (a_str + strlen(a_str) - 1);

    /* Add space for terminating null string so caller
       knows where the list of returned strings ends. */
    count++;

    result = malloc(sizeof(char*) * count);

    if (result)
    {
        size_t idx  = 0;
        char* token = strtok(a_str, delim);

        while (token)
        {
            assert(idx < count);
            *(result + idx++) = strdup(token);
            token = strtok(0, delim);
        }
        assert(idx == count - 1);
        *(result + idx) = 0;
    }

    return result;
}

void teks(){ 
  String a ;
  a= "";
  a = readString;
  char* input = &a[0u];
  
  char* input1 ;
  char* input2 ;
  char* input3 ;
    
  char** tokens=str_split(input,'|');
  if (tokens){
     int i;
     for (i = 0; *(tokens + i); i++)
     {     
      input1=*(tokens); 
      input2 =*(tokens+1);
      input3 =*(tokens+2);
     }
     printf("\n");
     free(tokens);
 }
    
  char* s= input3;
  char* s1= input1;
  char* s2= input2;
  String x = s;
  String x1 = s1;
  String x2 = s2;
  int    z = x.length();  
  int    z1 = x1.length();  
  int    z2 = x2.length();  
  
  waktu = millis();

  switch(z1){    
    case 13: cetakString(s1, 3, 23);
    break;
    case 12: cetakString(s1, 6, 23);
    break;
    case 11: cetakString(s1, 11, 23);
    break;
    case 10: cetakString(s1, 14, 23);
    break;
    case 9: cetakString(s1, 18, 23);
    break;
    case 8: cetakString(s1, 21, 23);
    break;
    case 7: cetakString(s1, 24, 23);
    break;
    case 6: cetakString(s1, 27, 23);
    break;
    case 5: cetakString(s1, 31, 23);
    break;
    case 4: cetakString(s1, 35, 23);
    break;
    case 3: cetakString(s1, 38, 23);
    break;
  }

  switch(z){
    case 13: cetakString(s, 3, 1);
    break;
    case 12: cetakString(s, 6, 1);
    break;
    case 11: cetakString(s, 11, 1);
    break;
    case 10: cetakString(s, 14, 1);
    break;
    case 9: cetakString(s, 18, 1);
    break;
    case 8: cetakString(s, 21, 1);
    break;
    case 7: cetakString(s, 24, 1);
    break;
    case 6: cetakString(s, 27, 1);
    break;
    case 5: cetakString(s, 31, 1);
    break;
    case 4: cetakString(s, 35, 1);
    break;
    case 3: cetakString(s, 38, 1);
    break;
  }

  switch(z2){
    case 13: cetakString(s2, 3, 12);
    break;
    case 12: cetakString(s2, 6, 12);
    break;
    case 11: cetakString(s2, 11, 12);
    break;
    case 10: cetakString(s2, 14, 12);
    break;
    case 9: cetakString(s2, 18, 12);
    break;
    case 8: cetakString(s2, 21, 12);
    break;
    case 7: cetakString(s2, 24, 12);
    break;
    case 6: cetakString(s2, 27, 12);
    break;
    case 5: cetakString(s2, 31, 12);
    break;
    case 4: cetakString(s2, 35, 12);
    break;
    case 3: cetakString(s2, 38, 12);
    break;
  }

  while ((millis() - waktu) > 5000) cetakKanvas();
  for (int z = 0; z<1000; z++) {  
  dx = random(2); dy = random(2);
  cetakKanvas();   
  }  
}
